## drivers/kernelsu/Kconfig
```kconfig
menu "KernelSU Ultra (3.x compatibility)"

config KSU
	bool "KernelSU core"
	default y

config KPM
	bool "Kernel patch manager compatibility"
	depends on KSU
	default y

config KSU_SUSFS
	bool "SUSFS (optional, risk-aware)"
	depends on KSU
	default n

endmenu
```

## drivers/oplus_healthinfo/Kconfig
```kconfig
config OPLUS_HEALTHINFO
	tristate "OPLUS health information procfs interface"
	depends on PROC_FS
	help
	  Provide the small /proc/oplus_healthinfo interface expected by
	  OPLUS/ColorOS userspace.  It exposes the current number of system-wide
	  I/O waiters and a writable alias for vm.swappiness.

	  This is intentionally limited to the two documented proc nodes and does
	  not implement any device-specific health monitoring.

	  If built as a module, it is called oplus_healthinfo.
```

## fs/susfs/Kconfig
```kconfig
config SUSFS_FS
	bool "SUSFS filesystem shim"
	depends on KSU_SUSFS
	default n
	help
	  Minimal SUSFS shim entry point for 3.x integration safety.
```
